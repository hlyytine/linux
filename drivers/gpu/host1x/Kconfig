## drivers/gpu/host1x/Kconfig
```kconfig
# SPDX-License-Identifier: GPL-2.0-only

config TEGRA_HOST1X_CONTEXT_BUS
	bool

config TEGRA_HOST1X
	tristate "NVIDIA Tegra host1x driver"
	depends on ARCH_TEGRA || COMPILE_TEST
	select DMA_SHARED_BUFFER
	select TEGRA_HOST1X_CONTEXT_BUS
	select IOMMU_IOVA
	help
	  Driver for the NVIDIA Tegra host1x hardware.

	  The Tegra host1x module is the DMA engine for register access to
	  Tegra's graphics- and multimedia-related modules. The modules served
	  by host1x are referred to as clients. host1x includes some other
	  functionality, such as synchronization.

if TEGRA_HOST1X

config TEGRA_HOST1X_NVIDIA_OOT
	bool "Use NVIDIA out-of-tree host1x driver instead"
	help
	  Say Y if using NVIDIA's out-of-tree (OOT) host1x driver from
	  nvidia-oot instead of the upstream in-tree driver.

	  The OOT driver provides extended APIs required by nvdisplay
	  (e.g., syncpoint shim support) that are not available in the
	  upstream driver.

	  When enabled, the in-tree host1x driver will not be built,
	  but CONFIG_TEGRA_HOST1X remains defined so that OOT modules
	  (nvgpu, nvdisplay, nvidia-oot) can compile correctly.

	  If unsure, say N.

config TEGRA_HOST1X_FIREWALL
	bool "Enable HOST1X security firewall"
	default y
	depends on !TEGRA_HOST1X_NVIDIA_OOT
	help
	  Say yes if kernel should protect command streams from tampering.

	  If unsure, choose Y.

endif
```
